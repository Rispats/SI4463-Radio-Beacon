#include <SPI.h>

#define START 0x8A
#define STOP 0x8B
#define ID 0xA1
#define SDN 7
#define CSN 10

uint8_t rad_cfg[] = { 
  0x07, 0x02, 0x01, 0x00, 0x01, 0xC9, 0xC3, 0x80,
  0x08, 0x13, 0x00, 0x00, 0x00, 0x00, 0x00, 0x00, 0x00,
  0x08, 0x11, 0x00, 0x04, 0x00, 0x52, 0x00, 0x18, 0x30,
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  0x0C, 0x11, 0x40, 0x08, 0x00, 0x3F, 0x0A, 0x51, 0xEB, 0xCC, 0xCD, 0x20, 0xFA
};

void send_cmd(uint8_t* d, uint8_t l) {
  digitalWrite(CSN, LOW);
  for (uint8_t i = 0; i < l; i++) SPI.transfer(d[i]);
  digitalWrite(CSN, HIGH);
}

bool cts() {
  for (uint8_t i = 0; i < 100; i++) {
    digitalWrite(CSN, LOW);
    SPI.transfer(0x44);
    delayMicroseconds(20);
    uint8_t c = SPI.transfer(0x00);
    digitalWrite(CSN, HIGH);
    if (c == 0xFF) return true;
    delay(5);
  }
  return false;
}

void init_radio() {
  digitalWrite(SDN, HIGH); delay(50);
  digitalWrite(SDN, LOW); delay(50);
  digitalWrite(CSN, HIGH);
  for (uint16_t i = 0; i < sizeof(rad_cfg); ) {
    uint8_t l = rad_cfg[i++];
    if (l == 0x00) break;
    send_cmd(&rad_cfg[i], l);
    i += l;
    cts();
  }
}

static inline uint8_t compute_checksum_sum(const char* s) {
  uint8_t cs = 0;
  for (const char* p = s; *p; ++p) cs += (uint8_t)(*p);
  return cs;
}

static inline char hex_digit(uint8_t v) {
  v &= 0x0F;
  return (v < 10) ? ('0' + v) : ('A' + (v - 10));
}

void send_payload_with_checksum(const char* payload, bool corrupt) {
  uint8_t pl_len = (uint8_t)strlen(payload);
  uint8_t cs = compute_checksum_sum(payload);
  char cs_hi = hex_digit(cs >> 4);
  char cs_lo = hex_digit(cs);

  // Buffer: [0]=0x66 cmd, [1]=START, [2]=ID, [3..]=payload, [3+pl_len]=STOP, [3+pl_len+1]=cs_hi, [3+pl_len+2]=cs_lo
  uint8_t buf[96];
  uint8_t idx = 0;
  buf[idx++] = 0x66; // WRITE_TX_FIFO
  buf[idx++] = START;
  buf[idx++] = ID;

  // Copy payload
  for (uint8_t i = 0; i < pl_len; i++) buf[idx + i] = (uint8_t)payload[i];

  // Optionally corrupt one character in the payload AFTER checksum computed
  if (corrupt && pl_len > 5) {
    // Flip one mid payload character to a different ASCII symbol
    uint8_t flip_pos = 1 + (pl_len / 2);
    if (buf[idx + flip_pos] != (uint8_t)'*') buf[idx + flip_pos] = (uint8_t)'*';
    else buf[idx + flip_pos] = (uint8_t)'-';
  }

  idx += pl_len;
  buf[idx++] = STOP;
  buf[idx++] = (uint8_t)cs_hi;
  buf[idx++] = (uint8_t)cs_lo;

  // Send to FIFO
  send_cmd(buf, idx);
  cts();

  // Start TX
  uint8_t total = (uint8_t)(idx - 1); // exclude the 0x66 command byte
  uint8_t tx[] = { 0x31, 0x00, 0x00, 0x00, total, 0x00, 0x00 };
  send_cmd(tx, sizeof(tx));
  cts();
}

void setup() {
  pinMode(SDN, OUTPUT);
  pinMode(CSN, OUTPUT);
  digitalWrite(CSN, HIGH);
  Serial.begin(115200);
  SPI.begin();
  SPI.beginTransaction(SPISettings(8000000, MSBFIRST, SPI_MODE0));
  init_radio();
  Serial.println("TX Ready");
}

uint8_t cnt = 0;

void loop() {
  // Payload format: YYYY-MM-DD,HH:MM:SS,latitude,longitude
  // Dummy but realistic values
  char payload[64];
  snprintf(payload, sizeof(payload), "2025-08-13,17:30:15,12.345678,77.654321");

  cnt++;
  bool corrupt = (cnt % 3 == 0); // 2 valid, then 1 corrupt
  send_payload_with_checksum(payload, corrupt);
  delay(2000);
}
